## sdkconfig.defaults
```kconfig
CONFIG_IDF_TARGET="esp32s2"
CONFIG_IDF_TARGET_ESP32S2=y
CONFIG_SDK_TOOLPREFIX="xtensa-esp32-elf-"
CONFIG_ESPTOOLPY_FLASHMODE_QIO=y
CONFIG_ESPTOOLPY_FLASHFREQ_40M=y
CONFIG_ESPTOOLPY_FLASHSIZE_4MB=y
CONFIG_PARTITION_TABLE_CUSTOM=y
CONFIG_ESP32S2_SPIRAM_SUPPORT=y
CONFIG_ESP_CONSOLE_UART_TX_GPIO=1
CONFIG_ESP_CONSOLE_UART_RX_GPIO=3
# CONFIG_ESP32_WIFI_ENABLE_WPA3_SAE is not set
CONFIG_LWIP_TCP_SYNMAXRTX=6
CONFIG_MBEDTLS_PSK_MODES=y
CONFIG_MBEDTLS_KEY_EXCHANGE_PSK=y
CONFIG_MBEDTLS_SSL_PROTO_DTLS=y

#
# ESP-WHO Configuration
#

#
# Wi-Fi Configuration
#
CONFIG_ESP_HOST_NAME=""
CONFIG_ESP_WIFI_SSID=""
CONFIG_ESP_WIFI_PASSWORD=""
CONFIG_ESP_WIFI_AP_SSID="ESP32-Camera"
CONFIG_ESP_WIFI_AP_PASSWORD=""
CONFIG_MAX_STA_CONN=1
CONFIG_ESP_WIFI_AP_CHANNEL=""
CONFIG_SERVER_IP="192.168.4.1"
CONFIG_ESP_MAXIMUM_RETRY=5
# end of Wi-Fi Configuration

#
# Camera Configuration
#
# CONFIG_CAMERA_MODULE_WROVER_KIT is not set
# CONFIG_CAMERA_MODULE_ESP_EYE is not set
CONFIG_CAMERA_MODULE_ESP_S2_KALUGA=y
# CONFIG_CAMERA_MODULE_ESP_S3_EYE is not set
# CONFIG_CAMERA_MODULE_ESP32_CAM_BOARD is not set
# CONFIG_CAMERA_MODULE_M5STACK_PSRAM is not set
# CONFIG_CAMERA_MODULE_M5STACK_WIDE is not set
# CONFIG_CAMERA_MODULE_AI_THINKER is not set
# CONFIG_CAMERA_MODULE_CUSTOM is not set
# end of Camera Configuration

#
# Model Configuration
#

#
# Face Recognition
#
CONFIG_MFN_V1=y
CONFIG_S8=y
# CONFIG_S16 is not set
# end of Face Recognition
# end of Model Configuration
# end of ESP-WHO Configuration


CONFIG_ESPTOOLPY_FLASHSIZE_4MB=y

CONFIG_ESPTOOLPY_FLASHFREQ_80M=y
CONFIG_ESPTOOLPY_FLASHMODE_QIO=y

CONFIG_SPIRAM_SPEED_80M=y


CONFIG_ESP32S2_DEFAULT_CPU_FREQ_240=y
CONFIG_ESP32S2_SPIRAM_SUPPORT=y

CONFIG_ESP32S2_DATA_CACHE_16KB=y
ESP32S2_DATA_CACHE_LINE_32B=y

CONFIG_CAMERA_MODULE_ESP_S2_KALUGA=y
CONFIG_LCD_DRIVER_SCREEN_CONTROLLER_ST7789=y
```
